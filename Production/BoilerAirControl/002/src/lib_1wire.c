#include "stm8s_conf.h"
//#include "main.h"
//#include "stdio.h"
//#include "string.h"

#include "lib_1wire.h"



/*****************************************************************************
*
*   Имя функции : x_delay
*
*   Возвращаемые значения : 
*
*   Параметры : задержка в условных попугаях. см. lib_1wire.h
*
*   Задача : генерация задержки
*            
*
*****************************************************************************/ 
void x_delay(unsigned int i) 
{ 
  while (--i) nop();
}

/*****************************************************************************
*
*   Имя функции : OneWire_Init
*
*   Возвращаемые значения : 1 - если функция инициализации прошла успешно (на шине есть устр-ва и временные
*                           рамки работы интерфейса 1-Wire соблюдены), 0 - в случае отсутствия ведомых устр-в 
*				            или проблем в работе шины.  
*
*   Параметры : Нет.
*
*   Задача : Функция инициализации обмена данными. Любой обмен информацией между ведомым и ведущим 
*            устр-вом начинается с этой функции. 
*            
*
*****************************************************************************/ 
unsigned char OneWire_Init(OW_Device * device)
{
  unsigned char i = 0xFF;
 
  ONE_WIRE_RESET;

  //delay_10us(48);
  delay_480us();
 
  ONE_WIRE_SET;
 
  //delay_10us(6);
  delay_60us();
 
  i = ONE_WIRE_READ;
 
  //delay_10us(48);
  delay_480us();
  // 0 означает правильный сброс, 1 - ошибка
  if(i == 0) return 0;
  else return 1;
}


/*****************************************************************************
*
*   Имя функции : OneWire_WriteBit
*
*   Возвращаемые значения : Нет. 
*
*   Параметры : Бит (1 или 0) подлежащий передаче.
*
*   Задача : Передача бита от ведущего устр-ва, ведомому. 
*            
*
*****************************************************************************/ 
void OneWire_WriteBit(OW_Device * device, unsigned char data_bit)
{
  disableInterrupts();
   	  
  ONE_WIRE_RESET;   
	  	
  if (data_bit)
    {
      ONE_WIRE_SET;
    }    		
  
  delay_60us();
       	
	    
  ONE_WIRE_SET;                	  					    
      
  enableInterrupts();
}


/*****************************************************************************
*
*   Имя функции : OneWire_ReadBit 
*
*   Возвращаемые значения : Принятый ведущим устр-вом бит. 
*
*   Параметры : Нет.
*
*   Задача : Прием бита от ведомого устр-ва.  
*            
*
*****************************************************************************/ 
unsigned char OneWire_ReadBit(OW_Device * device)
{
   unsigned char bBit = 0;
   
   disableInterrupts();

   ONE_WIRE_RESET; 
   delay_1us();
   ONE_WIRE_SET;   		
   delay_15us();  
   //delay_15us();

   if(ONE_WIRE_READ) bBit = 1;
                       						   						  
   delay_45us();	          
   
   enableInterrupts();

   return bBit;        
}


/*****************************************************************************
*
*   Имя функции : OneWire_WriteByte
*
*   Возвращаемые значения : Нет.
*
*   Параметры : Байт для передачи.
*
*   Задача : Передача байта от ведущего устр-ва, ведомому. 
*            
*
*****************************************************************************/ 

void OneWire_WriteByte(OW_Device * device, unsigned char data)
{ 
 unsigned char i = 8;
 
  while(i--)
  {
    OneWire_WriteBit(device, data & 0x01);
    data >>=1;
  }
    
}
  
/*****************************************************************************
*
*   Имя функции : OneWire_ReadByte
*
*   Возвращаемые значения : Принятый ведущим устр-вом байт. 
*
*   Параметры : Нет.
*
*   Задача : Прием байта от ведомого устр-ва. 
*            
*
*****************************************************************************/ 

unsigned char OneWire_ReadByte(OW_Device * device)
{
   char i = 8;
   unsigned char Data = 0;
   
   while(i--)
   {
     Data >>=1;
     Data |= OneWire_ReadBit(device) << 7;
   }
	
   
   return Data;        //Возвращаем принятый байт.
}




/*****************************************************************************
*
*   Имя функции : OneWire_SkipRom
*
*   Возвращаемые значения : Нет.
*
*   Параметры : Нет. 
*
*   Задача : Функция пропуска сравнивания серийных номеров. Команды следующие за этой функцией 
*            будут адрессоваться всем устр-вам на шине одновременно. 
*            
*
*****************************************************************************/ 

void OneWire_SkipRom(OW_Device * device)
{   
   OneWire_Init(device);
   OneWire_WriteByte(device, SKIP_ROM);  
}




