#include "stm8s_conf.h"
//#include "main.h"
//#include "stdio.h"
//#include "string.h"

#include "lib_max7219.h"



/* Private variables -----------------------------------------------------------*/


//*****************************************************************************
//              CHARSET ARRAY
//****************************************************************************
const uint8_t CharSet[] = {
0x7E, // 0
0x30, // 1
0x6d, // 2
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0x15, //n - 0x1A
0x47 //F - 0x1B
}; 


/* Public functions ----------------------------------------------------------*/


/*****************************************************************************
*
*   Имя функции : MAX7219_Shift
*
*   Возвращаемые значения : Нет
*
*   Параметры : Нет.
*
*   Задача :
*            
*            
*****************************************************************************/
void MAX7219_Shift(uint8_t u8Addr, uint8_t u8Data)
{
  MAX7219_CS_L;
  //
  SPI->DR = u8Addr;
  while ((SPI->SR & SPI_SR_TXE) == 0)
  {
    /* Wait while the byte is transmitted */
  }
  ///
  SPI->DR = u8Data;
  while ((SPI->SR & SPI_SR_TXE) == 0)
  {
    /* Wait while the byte is transmitted */
  }
  //
  
  for(char i = 0; i < 20; i++){nop();}
  ///
  MAX7219_CS_H;
}

/*****************************************************************************
*
*   Имя функции : MAX7219_Init
*
*   Возвращаемые значения : Нет
*
*   Параметры : uint8_t u8Bbightness - контрастность. 0x00 : 0x0F
*
*   Задача :
*            
*            
*****************************************************************************/
void MAX7219_Init(uint8_t u8Bbightness)
{
    MAX7219_Shift(0x0F, 0x00);//– Тест индикатора выключен
    MAX7219_Shift(0x0C, 0x01);//– Выйти из сна
    MAX7219_Shift(0x0B, 0x07);//– Кол-во задействованных символов — 8 символов
    MAX7219_Shift(0x09, 0x00);//– Дешифраторы отключены
    MAX7219_Shift(0x0A, u8Bbightness & 0x0F);//– Интенсивность свечения
    
    //очистить дисплей
    for(uint8_t i = 1; i < 9; i++)
    {
      MAX7219_Shift(i, 0);
    }  
}

/*****************************************************************************
*
*   Имя функции : MAX7219_SetBrightness
*
*   Возвращаемые значения : Нет
*
*   Параметры : uint8_t u8Bbightness - контрастность. 0x00 : 0x0F
*
*   Задача : Задать яркость свечения дисплея
*            
*            
*****************************************************************************/
void MAX7219_SetBrightness(uint8_t u8Bbightness)
{
    MAX7219_Shift(0x0A, u8Bbightness & 0x0F);//– Интенсивность свечения  
}

/*****************************************************************************
*
*   Имя функции : MAX7219_Clear
*
*   Возвращаемые значения : Нет
*
*   Параметры : Нет
*
*   Задача :
*            
*            
*****************************************************************************/
void MAX7219_Clear(void)
{
    //очистить дисплей
    for(uint8_t i = 1; i < 9; i++)
    {
      MAX7219_Shift(i, 0);
    }   
}

