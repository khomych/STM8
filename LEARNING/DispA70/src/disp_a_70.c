
#include "stm8s_conf.h"
#include "disp_a_70.h"
#include "main.h"



//***********************************************************
//Настройки контроллера дисплея и пеерменные для работы с ним
//***********************************************************


char power_down = 0;			//power-down control: 0 - chip is active, 1 - chip is in PD-mode

char addressing = 0;



unsigned char temp_control = 3;  	//температурный коэффициент, 0..3
unsigned char bias = 6;                 //смещение, 0..7

unsigned char Vop = 120;			//рабочее напрядение LCD, 0..127 (определяет контрастность)
unsigned char disp_config = 2;		//режим дисплея: 0 - blank, 1 - all on, 2 - normal, 3 - inverse



#define PIXEL_OFF	0		//режимы отображения пикселя - используются в графических функциях
#define PIXEL_ON	1
#define PIXEL_XOR	2



#define LCD_X_CHAR 20          //количество символов
#define LCD_Y_CHAR 8
#define LCD_X_RES               102	//разрешение экрана    
#define LCD_Y_RES               65    
#define LCD_CACHE_SIZE          LCD_X_RES*LCD_Y_RES/8  

char LCD_Buff[4][17];


#define LCD_CMD         0
#define LCD_DATA        1 

//***************************************************
//****************Прототипы функций******************
//***************************************************

//ASCII
const char table[0x0500] = 
{
0x00, 0x00, 0x00, 0x00, 0x00,// 00
0x00, 0x00, 0x5F, 0x00, 0x00,// 01
0x00, 0x07, 0x00, 0x07, 0x00,// 02
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0x48, 0x54, 0x34, 0x14, 0x7C }; // FF


/*
 0xFC,0xFE,0x07,0x83,0x43,0x23,0xFE,0xFC
 0x00,0x00,0x00,0x00,0x0F,0x1F,0x39,0x30
 0x30,0x30,0x1F,0x0F,0x00,0x00,0x00,0x00

 0x0C,0x0E,0x0E,0xFF,0xFF,0x00,0x00,0x00
 0x00,0x00,0x00,0x00,0x20,0x30,0x30,0x3F
 0x3F,0x30,0x30,0x20,0x00,0x00,0x00,0x00

 0x0E,0x06,0x83,0x83,0xC3,0xE7,0xFE,0x7C
 0x00,0x00,0x00,0x00,0x3E,0x3F,0x33,0x31
 0x31,0x30,0x30,0x30,0x00,0x00,0x00,0x00

 0x06,0x03,0x03,0xC3,0xC3,0xE7,0xFE,0x1C
 0x00,0x00,0x00,0x00,0x18,0x30,0x30,0x30
 0x30,0x39,0x1F,0x0E,0x00,0x00,0x00,0x00

 0xFF,0xFF,0xC0,0xC0,0xC0,0xC0,0xFF,0xFF
 0x00,0x00,0x00,0x00,0x00,0x00,0x00,0x00
 0x00,0x00,0x3F,0x3F,0x00,0x00,0x00,0x00

 0x7F,0x7F,0x63,0x63,0x63,0x63,0xC3,0x83
 0x00,0x00,0x00,0x00,0x18,0x30,0x30,0x30
 0x30,0x38,0x1F,0x0F,0x00,0x00,0x00,0x00




 0xFC,0xFE,0xE7,0x63,0x63,0xC3,0xC3,0x86
 0x00,0x00,0x00,0x00,0x0F,0x1F,0x38,0x30
 0x30,0x38,0x1F,0x0F,0x00,0x00,0x00,0x00

 0x03,0x03,0x03,0x03,0x03,0xF3,0xFF,0x0F
 0x00,0x00,0x00,0x00,0x00,0x00,0x00,0x38
 0x3F,0x07,0x00,0x00,0x00,0x00,0x00,0x00

 0x9C,0xFE,0xE7,0x43,0x43,0xE7,0xFE,0x9C
 0x00,0x00,0x00,0x00,0x0F,0x1F,0x38,0x30
 0x30,0x38,0x1F,0x0F,0x00,0x00,0x00,0x00

 0x3C,0xFE,0xC7,0x83,0x83,0xC7,0xFE,0xFC
 0x00,0x00,0x00,0x00,0x18,0x30,0x31,0x31
 0x31,0x39,0x1F,0x0F,0x00,0x00,0x00,0x00

*/

const char CharSet[160] = {
  0xFC,0xFE,0x07,0x83,0x43,0x23,0xFE,0xFC,0x0F,0x1F,0x39,0x30,0x30,0x30,0x1F,0x0F,
  0x0C,0x0E,0x0E,0xFF,0xFF,0x00,0x00,0x00,0x20,0x30,0x30,0x3F,0x3F,0x30,0x30,0x20,
  0x0E,0x06,0x83,0x83,0xC3,0xE7,0xFE,0x7C,0x3E,0x3F,0x33,0x31,0x31,0x30,0x30,0x30,
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  0x3C,0xFE,0xC7,0x83,0x83,0xC7,0xFE,0xFC,0x18,0x30,0x31,0x31,0x31,0x39,0x1F,0x0F
};

const char CharSet_Sin[32]={
  0xE0,0x30,0x18,0x0C,0x04,0x06,0x02,0x02,
  0x02,0x02,0x06,0x04,0x0C,0x18,0x30,0xE0,
  0x07,0x0C,0x18,0x30,0x20,0x60,0x40,0x40,
  0x40,0x40,0x60,0x20,0x30,0x18,0x0C,0x07
};

/*
const char CharSet_Sin[32]={
  0xE0,0x30,0x18,0x0C,0x04,0x06,0x02,0x02,
  0x02,0x02,0x06,0x04,0x0C,0x18,0x70,0xE0,
  0x07,0x0E,0x18,0x30,0x20,0x60,0x40,0x40,
  0x40,0x40,0x60,0x20,0x30,0x18,0x0C,0x07
  };*/

void delay(void)
{
  for(uint16_t i = 0; i < 10000; i++)nop();
}

void Reset_LCD(void)

{

  delay();


  A70_DC_L;
  delay();
  A70_RST_H;
  delay();
  A70_SCE_L;
  delay();
  A70_RST_L;
  delay(); 
  A70_RST_H;
  A70_SCE_H;

}



void LcdSend (unsigned char data, unsigned char cmd)    //Sends data to display controller
{
  A70_SCE_L;//Enable display controller (active low)
  if (cmd)
    {
      A70_DC_H;	//выбираем команда или данные
    }
  else
    {
	A70_DC_L;
    }
while (SPI_GetFlagStatus(SPI_FLAG_TXE)== RESET);
  SPI_SendData(data); //Send data to display controller
  
  while (SPI_GetFlagStatus(SPI_FLAG_BSY)== SET);
  //while (SPI_GetFlagStatus(SPI_FLAG_RXNE)== RESET);

        A70_SCE_H;                //Disable display controller
}


        
void LcdClear ( void )
{
        int j;

        LcdSend(0x80, LCD_CMD);		//команды установки указателя памяти дисплея на 0,0
        LcdSend(0x40, LCD_CMD);
                            		
		for (j = (LCD_CACHE_SIZE); j>0; j--) LcdSend(0x00, LCD_DATA);


}

void LcdInit (void)	//инициализация SPI и дисплея
{
  Reset_LCD();
			
  LcdSend( 0x21, LCD_CMD );
  LcdSend( 0xC8, LCD_CMD );
  LcdSend( 0x14, LCD_CMD );
  LcdSend( 0x0B, LCD_CMD );
  LcdSend( 0x05, LCD_CMD );
  LcdSend( 0x20, LCD_CMD );
  //LcdSend( 0x20, LCD_CMD );
  LcdSend( 0x11, LCD_CMD );
  LcdSend( 0x0C, LCD_CMD );
				
  /*
  LcdSend(0x21, LCD_CMD);  // Function set: extended instruction set    --21
  LcdSend(0x09, LCD_CMD);  // Bias System                               --14
  LcdSend(0x0A, LCD_CMD);  // HV-gen stages                             --0A
  LcdSend(0x05, LCD_CMD);  // Temperature Control                       --05
  LcdSend(0xCC, LCD_CMD);  // Contrast: 204                             --CC
  LcdSend(0x20, LCD_CMD);  // Function set: standard instruction set    --20
  LcdSend(0x11, LCD_CMD);  // VLCD programming range: high              --11
  LcdSend(0x0C, LCD_CMD);  // Display control: normal (inverted = 0x0D) --0C
  */
			
  //LcdClear();
}

void LcdContrast (unsigned char contrast) 	//contrast -> Contrast value from 0x00 to 0x7F
        {
        if (contrast > 0x7F) return;
        LcdSend( 0x21, LCD_CMD );               //LCD Extended Commands
        LcdSend( 0x80 | contrast, LCD_CMD );    //Set LCD Vop (Contrast)
        LcdSend( 0x20, LCD_CMD );               //LCD Standard Commands,Horizontal addressing mode
        }
        
void LcdMode (unsigned char mode) 		//режим дисплея: 0 - blank, 1 - all on, 2 - normal, 3 - inverse
        {
        if (mode > 3) return;
        LcdSend( 0x08|((mode<<1|mode)&0x05), LCD_CMD ); 	//LCD mode
        }
        
void LcdPwrMode (void) 				//инвертирует состояние вкл/выкл дисплея
        {
        power_down = ~power_down;
        LcdSend( 0x20|power_down<<3, LCD_CMD );
        }



void Lcd_Set_Curr(unsigned char x, unsigned char y)
{
LcdSend(0x80 + x, LCD_CMD);		//команды установки указателя памяти дисплея на необходимые координат
LcdSend(0x40 + (7 - y), LCD_CMD);
}






        


/*

void LcdChr (char ch)	//Displays a character at current cursor location and increment cursor location
 	{
    unsigned char j;
    
    SetCharIndex(CharIndex);
    for(j=0;j<5;j++)
       {
       LcdSend(table[(int) ch * 5 + j], LCD_DATA);
       }
    
    CharIndex++;
    if(CharIndex > 127)
       {
       CharIndex=0;
       LcdClear();
       }
    
 	}
  */
void LcdChrBig (int ch, unsigned char x, unsigned char y)	//Displays a character at current cursor location and increment cursor location
 	{
     	unsigned char i;
     	unsigned char a = 0, b = 0, c = 0;
     	
     	for ( i = 0; i < 5; i++ )
     	        {
     	        c = table[(ch*5+i)];		//выделяем столбец из символа
     	        
     	        b =  (c & 0x01) * 3;            //"растягиваем" столбец на два байта 
              	b |= (c & 0x02) * 6;
              	b |= (c & 0x04) * 12;
              	b |= (c & 0x08) * 24;
  
              	c >>= 4;
              	a =  (c & 0x01) * 3;
              	a |= (c & 0x02) * 6;
              	a |= (c & 0x04) * 12;
              	a |= (c & 0x08) * 24;
                
                Lcd_Set_Curr(x*6+i,y*2+0);
        
                LcdSend(b, LCD_DATA);
               // LcdSend(b, LCD_DATA);
                
                Lcd_Set_Curr(x*6+i,y*2+1);
        
                LcdSend(a, LCD_DATA);
                //LcdSend(a, LCD_DATA);

     	        }
     	}

void LcdDigit(uint8_t u8Digit, uint8_t u8XPos, uint8_t u8YPos)
{
  uint8_t data;
  uint8_t u8XOffset, u8YOffset;
  
  u8XOffset = u8XPos * 10;
  u8YOffset = u8YPos * 2;
  
  if(u8XPos > 6)
  {
    u8XOffset +=2;
  }
  else
  {
    if(u8XPos > 3)
    {
      u8XOffset +=1;
    }
  }
  
  u8Digit = u8Digit * 16;
  Lcd_Set_Curr(u8XOffset,u8YOffset);
  for(uint8_t i = 0; i < 8; i++)
  {
    data = CharSet[i + u8Digit];
    LcdSend(data,LCD_DATA);
  }
  
  Lcd_Set_Curr(u8XOffset,u8YOffset + 1);
  for(uint8_t i = 0; i <8; i++)
  {
    data = CharSet[i+8+u8Digit];
    LcdSend(data,LCD_DATA);
  }
  
}

void ShowSin(void)
{
  uint8_t data;
  
  Lcd_Set_Curr(0,2);
  for(uint8_t i = 0; i < 16; i++)
  {
    data = CharSet_Sin[i];
    LcdSend(data, LCD_DATA);
  }
  
  Lcd_Set_Curr(16,3);
    for(uint8_t i = 0; i < 16; i++)
  {
    data = CharSet_Sin[i + 16];
    LcdSend(data, LCD_DATA);
  }
 
    Lcd_Set_Curr(32,2);
  for(uint8_t i = 0; i < 16; i++)
  {
    data = CharSet_Sin[i];
    LcdSend(data, LCD_DATA);
  }
  
  Lcd_Set_Curr(48,3);
    for(uint8_t i = 0; i < 16; i++)
  {
    data = CharSet_Sin[i + 16];
    LcdSend(data, LCD_DATA);
  }
  
    Lcd_Set_Curr(64,2);
  for(uint8_t i = 0; i < 16; i++)
  {
    data = CharSet_Sin[i];
    LcdSend(data, LCD_DATA);
  }
  
  Lcd_Set_Curr(80,3);
    for(uint8_t i = 0; i < 16; i++)
  {
    data = CharSet_Sin[i + 16];
    LcdSend(data, LCD_DATA);
  }
  
}

void LcdUpdate(void)
{
char i, j;
for(i=0;i<4;i++)
   {
   for(j=0;j<17;j++)
      {
      LcdChrBig(LCD_Buff[i][j],j,i);
      }
   }
}






